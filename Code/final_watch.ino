#include <U8glib.h>
#include "MPU6050.h"
#include "Wire.h"
#include "MAX30105.h"
#include "heartRate.h"

U8GLIB_SSD1306_128X64 u8g(U8G_I2C_OPT_NO_ACK);  // Display which does not send ACK
int frame = 0;
int x;
int count=0;
int a[20];

char data = 0; 
void printValue();

MPU6050 accelgyro;

int16_t ax, ay, az;
int16_t gx, gy, gz;

#define LED_PIN 13
bool blinkState = false;


MAX30105 particleSensor;

const byte RATE_SIZE = 10; //Increase this for more averaging. 4 is good.
byte rates[RATE_SIZE]; //Array of heart rates
byte rateSpot = 0;
long lastBeat = 0; //Time at which the last beat occurred

float beatsPerMinute;
int beatAvg;
unsigned long pt = 0;

const uint8_t frame1[] PROGMEM = {
0x00, 0x00, 0x00, 0x00, 0x0F, 0xFF, 0xFE, 0x00, 0x3F, 0xFF, 0xFF, 0x00, 0x3F, 0xFF, 0xFF, 0x80,
0x30, 0x00, 0x01, 0x80, 0x33, 0xFF, 0x81, 0xC0, 0x33, 0xFF, 0x81, 0xE0, 0x33, 0xFF, 0x81, 0xE0,
0x33, 0xFF, 0x81, 0xE0, 0x33, 0xFF, 0x81, 0xE0, 0x33, 0xFF, 0x81, 0xE0, 0x33, 0xFF, 0x81, 0xE0,
0x33, 0xFF, 0x81, 0xE0, 0x33, 0xFF, 0x81, 0xC0, 0x30, 0x00, 0x01, 0x80, 0x3F, 0xFF, 0xFF, 0x80,
0x3F, 0xFF, 0xFF, 0x00, 0x0F, 0xFF, 0xFE, 0x00, 0x00, 0x00, 0x00, 0x00,  
};

const uint8_t frame2[] PROGMEM = {
0x00, 0x00, 0x00, 0x00, 0x08, 0x00, 0x00, 0x0C, 0x00, 0x00, 0x0F, 0x00, 0x00, 0x09, 0x80, 0x00,
0x08, 0xE0, 0x00, 0x08, 0x38, 0x00, 0x08, 0x1C, 0x0C, 0x08, 0x0F, 0x06, 0x08, 0x1C, 0x03, 0x88,
0x70, 0x00, 0xC8, 0xE0, 0x00, 0x79, 0x80, 0x00, 0x1E, 0x00, 0x00, 0x1E, 0x00, 0x00, 0x79, 0x80,
0x00, 0xC8, 0xE0, 0x03, 0x88, 0x70, 0x06, 0x08, 0x1C, 0x0C, 0x08, 0x0F, 0x00, 0x08, 0x1C, 0x00,
0x08, 0x38, 0x00, 0x08, 0xE0, 0x00, 0x09, 0xC0, 0x00, 0x0F, 0x00, 0x00, 0x0C, 0x00, 0x00, 0x08,
0x00, 0x00, 0x00, 0x00, 0x00, 0x00, 0x00, 0x00, 0x00, 0x00, 0x00, 0x00, 0x00, 0x00, 0x00, 0x00,
0x00, 0x00, 
};

const uint8_t frame3 [] = {
0x00, 0x00, 0x00, 0x00, 0x00, 0x00, 0x80, 0x00, 0x00, 0x01, 0x80, 0x00, 0x00, 0x01, 0x80, 0x00,
0x00, 0x01, 0xC0, 0x00, 0x00, 0x01, 0xC0, 0x00, 0x00, 0x03, 0xC0, 0x00, 0x00, 0x03, 0xC0, 0x00,
0x00, 0x03, 0xC0, 0x00, 0x00, 0x03, 0xC0, 0x00, 0x00, 0x02, 0x40, 0x00, 0x00, 0x06, 0x40, 0x00,
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0x00, 0x00, 0x00, 0x00, 0x00, 0x00, 0x00, 0x00, 0x00, 
};


const uint8_t frame4[] PROGMEM = {
0x00, 0x00, 0x00, 0x00, 0x00, 0x00, 0x00, 0x00, 0x00, 0x00, 0x00, 0x00, 0x00, 0x00, 0x00, 0x00,
0x00, 0x00, 0x00, 0x00, 0x00, 0x00, 0x7F, 0xE0, 0x00, 0x00, 0x01, 0xFF, 0xF8, 0x00, 0x00, 0x07,
0xFF, 0xFE, 0x00, 0x00, 0x1F, 0xFF, 0xFF, 0x00, 0x00, 0x3F, 0xFF, 0xFF, 0x80, 0x00, 0x7F, 0xFF,
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0x00, 0x00, 0x00, 0x00, 0x00, 0x00, 0x00, 
};
void setup(void) {
  Serial.begin(9600);
  accelgyro.initialize();
  particleSensor.setup(); //Configure sensor with default settings
  particleSensor.setPulseAmplitudeRed(0x6A); //Turn Red LED to low to indicate sensor is running
  particleSensor.setPulseAmplitudeGreen(0x4A); //Turn off Green LED
}

void loop(void) {

// read raw accel/gyro measurements from device
     accelgyro.getMotion6(&ax, &ay, &az, &gx, &gy, &gz);

    // these methods (and a few others) are also available
    //accelgyro.getAcceleration(&ax, &ay, &az);
    //accelgyro.getRotation(&gx, &gy, &gz);

   /*#ifdef OUTPUT_READABLE_ACCELGYRO
        // display tab-separated accel/gyro x/y/z values
        Serial.print("\nA:\t");
        Serial.print(ax); Serial.print("\t");
        Serial.print(ay); Serial.print("\t");
        Serial.print(az); Serial.print("\t");
        Serial.print(" G:\t");
        Serial.print(gx); Serial.print("\t");
        Serial.print(gy); Serial.print("\t");
        Serial.println(gz);
    #endif

    #ifdef OUTPUT_BINARY_ACCELGYRO
        Serial.write((uint8_t)(ax >> 8)); Serial.write((uint8_t)(ax & 0xFF));
        Serial.write((uint8_t)(ay >> 8)); Serial.write((uint8_t)(ay & 0xFF));
        Serial.write((uint8_t)(az >> 8)); Serial.write((uint8_t)(az & 0xFF));
        Serial.write((uint8_t)(gx >> 8)); Serial.write((uint8_t)(gx & 0xFF));
        Serial.write((uint8_t)(gy >> 8)); Serial.write((uint8_t)(gy & 0xFF));
        Serial.write((uint8_t)(gz >> 8)); Serial.write((uint8_t)(gz & 0xFF));
    #endif

    */


  //OPTICL HEART RATE SENSOR
  unsigned long ct = millis();
  long irValue = particleSensor.getIR();
    
  if (checkForBeat(irValue) == true)
  {
    //We sensed a beat!
   
    long delta = millis() - lastBeat;
    lastBeat = millis();
    
    beatsPerMinute = 60 / (delta / 1000.0);
  
  }
  if(ct-pt>=10000){
    printValue();
    pt = ct;
    }
  if (irValue < 50000){
    Serial.print("\n No finger?");
    pt=ct;  
  }

  if(Serial.available() > 0)      // Send data only when you receive data:
   {
      data = Serial.read();        //Read the incoming data & store into data
      Serial.print(data);          //Print Value inside data in Serial monitor
      Serial.print("\n");     
}
 
x = analogRead(A0);

a[count]=x;
count++;

if(count==21)
{ 
 count=0;
 int z;
 for(int i=0; i<=20; i++)
 {
  z += a[i];
 }

 u8g.firstPage();
 do{
   if(frame == 0 && z<11880 && z>8000)
   {  u8g.drawBitmapP(0,0,4,20,frame1);
      u8g.drawBitmapP(103,0,3.5,28, frame2); 
      u8g.setFont(u8g_font_helvR24);
      u8g.setColorIndex(1);
      u8g.drawStr(20,45,"11:45");
      u8g.setFont(u8g_font_helvB12);
      u8g.drawStr(100,60,"AM");
   }
   if(frame == 1 && z<11880 && z>8000)
   { u8g.setFont(u8g_font_profont22);
     u8g.setColorIndex(1);
     u8g.drawStr(0,20,"Heart Rate");
     u8g.setFont(u8g_font_helvR24);
     u8g.drawStr(25,60,"75"); 
     u8g.setFont(u8g_font_helvB12);
     u8g.drawStr(90,60,"BPM");
   }
   if(frame == 2 && z<6600)
   {  u8g.setFont(u8g_font_profont22);
      u8g.setColorIndex(1);
      u8g.drawStr(10,20,"Analysing");
      u8g.drawBitmap(10,30,4,32, frame3);
      u8g.setFont(u8g_font_helvR24);
      u8g.setColorIndex(1);
      u8g.drawStr(50,58,"10");
      u8g.setFont(u8g_font_profont22);
      u8g.drawStr(90,58,"sec");
   }  
    if(frame == 3 && z<6600)
   {  u8g.setFont(u8g_font_profont22);
      u8g.setColorIndex(1);
      u8g.drawStr(10,20,"Analysing");
      u8g.drawBitmap(10,30,4,32, frame3);
      u8g.setFont(u8g_font_helvR24);
      u8g.setColorIndex(1);
      u8g.drawStr(60,58,"9");
      u8g.setFont(u8g_font_profont22);
      u8g.drawStr(90,58,"sec");
   }
    if(frame == 4 && z<6600)
   { u8g.setFont(u8g_font_profont22);
      u8g.setColorIndex(1);
      u8g.drawStr(10,20,"Analysing");
      u8g.drawBitmap(10,30,4,32, frame3);
      u8g.setFont(u8g_font_helvR24);
      u8g.setColorIndex(1);
      u8g.drawStr(60,58,"8");
      u8g.setFont(u8g_font_profont22);
      u8g.drawStr(90,58,"sec");
   }
    if(frame == 5 && z<6600)
   { u8g.setFont(u8g_font_profont22);
      u8g.setColorIndex(1);
      u8g.drawStr(10,20,"Analysing");
      u8g.drawBitmap(10,30,4,32, frame3);
      u8g.setFont(u8g_font_helvR24);
      u8g.setColorIndex(1);
      u8g.drawStr(60,58,"7");
      u8g.setFont(u8g_font_profont22);
      u8g.drawStr(90,58,"sec");
   }
    if(frame == 6 && z<6600)
   { u8g.setFont(u8g_font_profont22);
      u8g.setColorIndex(1);
      u8g.drawStr(10,20,"Analysing");
      u8g.drawBitmap(10,30,4,32, frame3);
      u8g.setFont(u8g_font_helvR24);
      u8g.setColorIndex(1);
      u8g.drawStr(60,58,"6");
      u8g.setFont(u8g_font_profont22);
      u8g.drawStr(90,58,"sec");
   }
    if(frame == 7 && z<6600)
   {  u8g.setFont(u8g_font_profont22);
      u8g.setColorIndex(1);
      u8g.drawStr(10,20,"Analysing");
      u8g.drawBitmap(10,30,4,32, frame3);
      u8g.setFont(u8g_font_helvR24);
      u8g.setColorIndex(1);
      u8g.drawStr(60,58,"5");
      u8g.setFont(u8g_font_profont22);
      u8g.drawStr(90,58,"sec");
   }
    if(frame == 8 && z<6600)
   {  u8g.setFont(u8g_font_profont22);
      u8g.setColorIndex(1);
      u8g.drawStr(10,20,"Analysing");
      u8g.drawBitmap(10,30,4,32, frame3);
      u8g.setFont(u8g_font_helvR24);
      u8g.setColorIndex(1);
      u8g.drawStr(60,58,"4");
      u8g.setFont(u8g_font_profont22);
      u8g.drawStr(90,58,"sec");
   }
    if(frame == 9 && z<6600)
   {  u8g.setFont(u8g_font_profont22);
      u8g.setColorIndex(1);
      u8g.drawStr(10,20,"Analysing");
      u8g.drawBitmap(10,30,4,32, frame3);
      u8g.setFont(u8g_font_helvR24);
      u8g.setColorIndex(1);
      u8g.drawStr(60,58,"3");
      u8g.setFont(u8g_font_profont22);
      u8g.drawStr(90,58,"sec");
   }
    if(frame == 10 && z<6600)
   {  u8g.setFont(u8g_font_profont22);
      u8g.setColorIndex(1);
      u8g.drawStr(10,20,"Analysing");
      u8g.drawBitmap(10,30,4,32, frame3);
      u8g.setFont(u8g_font_helvR24);
      u8g.setColorIndex(1);
      u8g.drawStr(60,58,"2");
      u8g.setFont(u8g_font_profont22);
      u8g.drawStr(90,58,"sec");
   }
    if(frame == 11 && z<6600)
   {  u8g.setFont(u8g_font_profont22);
      u8g.setColorIndex(1);
      u8g.drawStr(10,20,"Analysing");
      u8g.drawBitmap(10,30,4,32, frame3);
      u8g.setFont(u8g_font_helvR24);
      u8g.setColorIndex(1);
      u8g.drawStr(60,58,"1");
      u8g.setFont(u8g_font_profont22);
      u8g.drawStr(90,58,"sec");
   }
   if(frame == 12 )
    {u8g.drawBitmapP(45,0,5.375,43, frame4);
       u8g.setFont(u8g_font_profont22);
      u8g.setColorIndex(1);
      u8g.drawStr(45,58,"Done");
    } 
  }while(u8g.nextPage());
 } 
 delay(30);  
 frame++;
 if(frame==14)
 frame=0;
}

void printValue(){

  Serial.print("\nBPM=");
  Serial.print(beatsPerMinute);
  
}

